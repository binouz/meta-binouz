## conf/layer.conf
```bitbake
# We have a conf and classes directory, append to BBPATH
BBPATH .= ":${LAYERDIR}"

# We have a recipes directory containing .bb and .bbappend files, add to BBFILES
BBFILES += "${LAYERDIR}/recipes*/*/*.bb \
            ${LAYERDIR}/recipes*/*/*.bbappend"

BBFILE_COLLECTIONS += "binouz"
BBFILE_PATTERN_binouz := "^${LAYERDIR}/"
BBFILE_PRIORITY_binouz = "9"

LAYERSERIES_COMPAT_binouz = "thud"

# Additional license directories.
LICENSE_PATH += "${LAYERDIR}/files/custom-licenses"
```
